## nRF52810_FW/boards/arm/basic_nrf52810/Kconfig.basic_nrf52810
```kconfig
# Copyright (c) 2021 Nordic Semiconductor ASA
# SPDX-License-Identifier: Apache-2.0

config BOARD_BASIC_NRF52810
	select SOC_NRF52810_QFAA
```

## nRF52810_FW/boards/arm/basic_nrf52810/basic_nrf52810_defconfig
```kconfig
# Copyright (c) 2021 Nordic Semiconductor ASA
# SPDX-License-Identifier: Apache-2.0

CONFIG_SERIAL=y
CONFIG_CONSOLE=y
CONFIG_UART_CONSOLE=y

CONFIG_PINCTRL=y
```

## nRF52810_FW/boards/arm/basic_nrf52810/board.yml
```yaml
# Copyright (c) 2024 Nordic Semiconductor ASA
# SPDX-License-Identifier: Apache-2.0

board:
  name: basic_nrf52810
  vendor: arm
  socs:
    - name: nrf52810
```

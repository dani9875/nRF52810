## nRF52810_FW/app/boards/Kconfig.bt_hid_opt_mouse
```kconfig
# Copyright (c) 2021 Nordic Semiconductor ASA
# SPDX-License-Identifier: Apache-2.0

config BOARD_BT_HID_OPT_MOUSE
	select SOC_NRF52810_QFAA
```

## nRF52810_FW/app/boards/board.yml
```yaml
board:
  name: bt_hid_opt_mouse
  full_name: BT HID optical mouse
  vendor: perseluspy
  socs:
  - name: nrf52810
```

## nRF52810_FW/app/boards/bt_hid_opt_mouse_defconfig
```kconfig
# Copyright (c) 2021 Nordic Semiconductor ASA
# SPDX-License-Identifier: Apache-2.0

CONFIG_GPIO=y
#CONFIG_USE_SEGGER_RTT=y
```

## nRF52810_FW/app/boards/custom_succ_build_board/board.yml
```yaml
board:
  name: custom_plank
  full_name: nRF52810 DK
  vendor: nordic
  socs:
  # Physical nRF52840 SoC on PCA10056
  - name: nrf52810
```
